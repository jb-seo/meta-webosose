## meta-webos-freescale/conf/layer.conf
```bitbake
BBPATH ?= ""
# We have a conf and classes directory, add to BBPATH
BBPATH .= ":${LAYERDIR}"
# We have a packages directory, add to BBFILES
BBFILES += "${LAYERDIR}/recipes-*/*/*.bb ${LAYERDIR}/recipes-*/*/*.bbappend"

BBFILE_COLLECTIONS += "meta-webos-freescale"
BBFILE_PATTERN_meta-webos-freescale := "^${LAYERDIR}/"
BBFILE_PRIORITY_meta-webos-freescale= "52"
```
